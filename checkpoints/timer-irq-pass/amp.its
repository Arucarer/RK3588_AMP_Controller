## checkpoints/timer-irq-pass/amp.its
```
/dts-v1/;

/ {
	description = "RK3588 AMP bootstrap";
	#address-cells = <1>;

	images {
		amp3 {
			description = "a55-bootstrap";
			data = /incbin/("../../build/amp_bootstrap.bin");
			type = "firmware";
			compression = "none";
			arch = "arm64";
			cpu = <0x300>;
			hyp = <0>;
			thumb = <0>;
			load = <0x20000000>;
			boot-on = <1>;

			hash {
				algo = "sha256";
			};
		};
	};

	configurations {
		default = "conf";

		conf {
			description = "Linux and A55 bootstrap";
			loadables = "amp3";

			linux {
				description = "linux-os";
				arch = "arm64";
				cpu = <0x000>;
				hyp = <0>;
				thumb = <0>;
			};
		};
	};
};
```
